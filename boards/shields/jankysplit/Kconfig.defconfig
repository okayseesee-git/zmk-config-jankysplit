## boards/shields/jankysplit/Kconfig.defconfig
```kconfig
if SHIELD_JANKYSPLIT_LEFT
  
config ZMK_KEYBOARD_NAME
    default "jankysplit"

config ZMK_SPLIT_ROLE_CENTRAL
    default y

endif

if SHIELD_JANKYSPLIT_RIGHT

config ZMK_SPLIT
    default y


endif
```

## boards/shields/jankysplit/Kconfig.shield
```kconfig
config SHIELD_JANKYSPLIT_LEFT
  def_bool $(shields_list_contains,jankysplit_left)

config SHIELD_JANKYSPLIT_RIGHT
  def_bool $(shields_list_contains,jankysplit_RIGHT)
```
